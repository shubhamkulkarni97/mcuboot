## boot/zephyr/boards/esp32.conf
```kconfig
CONFIG_I2C=n
CONFIG_I2C_ESP32=n
CONFIG_I2C_0=n
CONFIG_I2C_1=n
CONFIG_BOOTLOADER_ESP_IDF=n
CONFIG_BOOTLOADER_MCUBOOT=n
CONFIG_HEAP_MEM_POOL_SIZE=0
CONFIG_MINIMAL_LIBC_MALLOC_ARENA_SIZE=0
CONFIG_POSIX_API=n
CONFIG_THREAD_CUSTOM_DATA=n
CONFIG_DYNAMIC_INTERRUPTS=n
CONFIG_LOG=n

CONFIG_SINGLE_APPLICATION_SLOT=y
CONFIG_BOOT_VALIDATE_SLOT0=n
```
