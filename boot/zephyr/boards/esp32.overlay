
&flash0 {
	partitions {
			compatible = "fixed-partitions";
			#address-cells = <1>;
			#size-cells = <1>;

			boot_partition: partition@1000 {
				label = "mcuboot";
				reg = <0x000001000 0x00007000>;
			};
			slot0_partition: partition@10000 {
				label = "image-0";
				reg = <0x000010000 0x00100000>;
			};
    };
};
